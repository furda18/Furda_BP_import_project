## prj.conf
```kconfig
# Incresed stack due to settings API usage
CONFIG_SYSTEM_WORKQUEUE_STACK_SIZE=2048

CONFIG_BT=y
CONFIG_BT_DEBUG_LOG=y
CONFIG_BT_SMP=y
CONFIG_BT_SIGNING=y
CONFIG_BT_PERIPHERAL=y
CONFIG_BT_DIS=y
CONFIG_BT_ATT_PREPARE_COUNT=5
CONFIG_BT_BAS=y
CONFIG_BT_HRS=y
CONFIG_BT_PRIVACY=y
CONFIG_BT_DEVICE_NAME="Thingy52 Project"
CONFIG_BT_DEVICE_APPEARANCE=833
CONFIG_BT_DEVICE_NAME_DYNAMIC=y
CONFIG_BT_DEVICE_NAME_MAX=65

CONFIG_BT_KEYS_OVERWRITE_OLDEST=y
CONFIG_BT_SETTINGS=y
CONFIG_FLASH=y
CONFIG_FLASH_PAGE_LAYOUT=y
CONFIG_FLASH_MAP=y
CONFIG_NVS=y
CONFIG_SETTINGS=y

CONFIG_STDOUT_CONSOLE=y
CONFIG_I2C=y
CONFIG_SENSOR=y
CONFIG_HTS221=y
CONFIG_HTS221_TRIGGER_NONE=y
CONFIG_CBPRINTF_FP_SUPPORT=y

# choose RTT console
CONFIG_UART_CONSOLE=n
CONFIG_USE_SEGGER_RTT=y
CONFIG_RTT_CONSOLE=y

# General config
CONFIG_LOG=y
CONFIG_LOG_DEFAULT_LEVEL=4
```

## src/main.c
```c
/* main.c - Application main entry point */
#include <zephyr/types.h>
#include <stddef.h>
#include <errno.h>
#include <sys/printk.h>
#include <sys/byteorder.h>

#include <settings/settings.h>

#include <bluetooth/bluetooth.h>
#include <bluetooth/hci.h>
#include <bluetooth/conn.h>
#include <bluetooth/uuid.h>
#include <bluetooth/gatt.h>
#include <bluetooth/services/bas.h>
#include <bluetooth/services/hrs.h>

#include "cts.h"

// my solution
#include "my_solution.c"

/*Flashing Preamle*/
#include <zephyr.h>
#include <sys/reboot.h>
#include <device.h>
#include <string.h>
#include <drivers/flash.h>
#include <storage/flash_map.h>
#include <fs/nvs.h>

/*LED Preamble*/

#include <devicetree.h>
#include <drivers/gpio.h>

/* 1000 msec = 1 sec */
#define SLEEP_TIME_MS 1000


#include <stdlib.h> //for using the function sleep
#include <stdio.h>
#include <time.h>




/* Custom Service Variables */
#define BT_UUID_CUSTOM_SERVICE_VAL \
	BT_UUID_128_ENCODE(0x00000000, 0x1234, 0x5678, 0x1234, 0x56789abcdef0)


static const struct bt_uuid_128 char1_signed_uuid = BT_UUID_INIT_128(
	BT_UUID_128_ENCODE(0x13345678, 0x1234, 0x5678, 0x1334, 0x56789abcdef8));

static struct bt_uuid_128 vnd_uuid = BT_UUID_INIT_128(
	BT_UUID_CUSTOM_SERVICE_VAL);

static struct bt_uuid_128 vnd_enc_uuid = BT_UUID_INIT_128(
	BT_UUID_128_ENCODE(0x12345678, 0x1234, 0x5678, 0x1234, 0x56789abcdef1));

static struct bt_uuid_128 vnd_auth_uuid = BT_UUID_INIT_128(
	BT_UUID_128_ENCODE(0x12345678, 0x1234, 0x5678, 0x1234, 0x56789abcdef2));

#define VND_MAX_LEN 20

static ssize_t read_vnd(struct bt_conn *conn, const struct bt_gatt_attr *attr,
			void *buf, uint16_t len, uint16_t offset)
{
	const char *value = attr->user_data;

	return bt_gatt_attr_read(conn, attr, buf, len, offset, value,
				 strlen(value));
}

static ssize_t write_vnd(struct bt_conn *conn, const struct bt_gatt_attr *attr,
			 const void *buf, uint16_t len, uint16_t offset,
			 uint8_t flags)
{
	uint8_t *value = attr->user_data;

	if (offset + len > VND_MAX_LEN) {
		return BT_GATT_ERR(BT_ATT_ERR_INVALID_OFFSET);
	}

	memcpy(value + offset, buf, len);
	value[offset + len] = 0;

	return len;
}

static uint8_t simulate_vnd;
static uint8_t indicating;
static struct bt_gatt_indicate_params ind_params;

static void vnd_ccc_cfg_changed(const struct bt_gatt_attr *attr, uint16_t value)
{
	simulate_vnd = (value == BT_GATT_CCC_INDICATE) ? 1 : 0;
}

static void indicate_cb(struct bt_conn *conn,
			struct bt_gatt_indicate_params *params, uint8_t err)
{
	printk("Indication %s\n", err != 0U ? "fail" : "success");
}

static void indicate_destroy(struct bt_gatt_indicate_params *params)
{
	printk("Indication complete\n");
	indicating = 0U;
}





static const struct bt_uuid_128 vnd_long_uuid = BT_UUID_INIT_128(
	BT_UUID_128_ENCODE(0x12345678, 0x1234, 0x5678, 0x1234, 0x56789abcdef3));

static struct bt_gatt_cep vnd_long_cep = {
	.properties = BT_GATT_CEP_RELIABLE_WRITE,
};

static int signed_value;
static int signed_value1;
static int signed_value2;
static int len_of_value;

typedef void (*some_random_function)();
static char *value_written;
int value_written_length = 0;

char my_value_ok[100];


static int signed_value;
static int signed_value1;





static ssize_t read_char2(struct bt_conn *conn, const struct bt_gatt_attr *attr,
			   void *buf, uint16_t len, uint16_t offset)
{         
        /* originally const char, t*/
	char *value = attr->user_data;
       
        int counter = 0;

        //printk("value_written_length: %d\n", value_written_length);
        
        printf("READ:\n");
        for (int i = 0; i < 100; i++){
          printf("value[%d] = ", i);
          printf("%" PRIx32 "\n", value[i]);   
          //if(value[i] == 0){
          //  counter++;
          //}
        }

        
        printk("len=%d  sizeof(key)=%d strlen(key)=%d\n", len, sizeof(key), strlen(key));

        rc = nvs_read(&fs, KEY_ID, &key, 100);
        if (rc > 0) { /* item was found, show it */
		printk("Id: %d, THE Key is: ", KEY_ID);
		for (int n = 0; n < 100; n++) {
			printk("%x ", key[n]);
		}
		printk("\n");
        }

       

        // if input is 000000, all bytes are reseted to 0
        //if(counter == 3){
        //   printk("00-00-00 configuration, rewriting for key! \n");
        //   for (int i = 0; i < len; i++){           
        //      value[i] = key[i];
        //      printk("%x to %x ", value[i], key[i]);
        //   }
        //}    
	//return bt_gatt_attr_read(conn, attr, buf, len, offset, value,
	//			 strlen(value));

        return bt_gatt_attr_read(conn, attr, buf, len, offset, value,
				 100);
       
}


static ssize_t write_char2(struct bt_conn *conn, const struct bt_gatt_attr *attr,
			    const void *buf, uint16_t len, uint16_t offset,
			    uint16_t flags)
{         
        uint8_t *value = attr->user_data;
        
        

        LOG_INF("Dlzka prijatych dat: %d\n", len);
        value_written = value;
        value_written_length = len;

	memcpy(value + offset, buf, len);     
        
        len_of_value = len;
	/* KEY_ID is used to store a key, lets see if we can read it from flash */
	rc = nvs_read(&fs, KEY_ID, &key, sizeof(key));

        //printk("SIZEOF KEY: %d", sizeof(key));
        rc = 1;
        if (rc > 0) { /* item was found, show it */
		
                for (int n = 0; n < 100; n++) {
			//printk("%x ", key[n]);
                        key[n] = value[n];
                        my_value_ok[n] = value[n];
                        if(n>len){
                          key[n] = 0;
                        }
		}
                (void)nvs_write(&fs, KEY_ID, &key, sizeof(key));
                printf("-.-.->\n");
		for (int n = 0; n < len; n++) {
			printk("%d. %x \n", n, key[n]);  
                        //printk("%d. %x \n", n, my_value_ok[n]);            
		}
		printk("\n");
	} else   {/* item was not found, add it */
		for (int n = 0; n < 100; n++) {
			my_value_ok[n] = value[n];
                        key[n] = value[n];
                        if(n>len){
                          key[n] = 0;
                        }
		}
		(void)nvs_write(&fs, KEY_ID, &key, sizeof(key));
                printf("--->\n");
                for (int n = 0; n < 100; n++) {
			printk("%d. %x \n", n, key[n]);  
                        //printk("%d. %x \n", n, my_value_ok[n]);             
		}
	}
        
       
        
        //value_written_length = len;
        //printk("value_written_length: %d\n", value_written_length);
        
        //must be true to execute resolve
        config_has_been_written = true;
     
	return len;
}




static const struct bt_uuid_128 char2_signed_uuid = BT_UUID_INIT_128(
	BT_UUID_128_ENCODE(0x11111111, 0x1234, 0x5678, 0x1334, 0x56789abcdef7));



static ssize_t write_without_rsp_vnd(struct bt_conn *conn,
				     const struct bt_gatt_attr *attr,
				     const void *buf, uint16_t len, uint16_t offset,
				     uint8_t flags)
{
	uint8_t *value = attr->user_data;

	if (!(flags & BT_GATT_WRITE_FLAG_CMD)) {
		/* Write Request received. Reject it since this Characteristic
		 * only accepts Write Without Response.
		 */
		return BT_GATT_ERR(BT_ATT_ERR_WRITE_REQ_REJECTED);
	}

	if (offset + len > VND_MAX_LEN) {
		return BT_GATT_ERR(BT_ATT_ERR_INVALID_OFFSET);
	}

	memcpy(value + offset, buf, len);
	value[offset + len] = 0;
	return len;
}

/* Vendor Primary Service Declaration */
BT_GATT_SERVICE_DEFINE(vnd_svc,
	BT_GATT_PRIMARY_SERVICE(&vnd_uuid),
        //Charakteristika 2
        BT_GATT_CHARACTERISTIC(&char2_signed_uuid.uuid, BT_GATT_CHRC_READ |
			       BT_GATT_CHRC_WRITE | BT_GATT_CHRC_AUTH,
			       BT_GATT_PERM_READ | BT_GATT_PERM_WRITE,
			       read_char2, write_char2, &signed_value2),
        
	
);

static const struct bt_data ad[] = {
	BT_DATA_BYTES(BT_DATA_FLAGS, (BT_LE_AD_GENERAL | BT_LE_AD_NO_BREDR)),
	BT_DATA_BYTES(BT_DATA_UUID16_ALL,
		      BT_UUID_16_ENCODE(BT_UUID_HRS_VAL),
		      BT_UUID_16_ENCODE(BT_UUID_BAS_VAL),
		      BT_UUID_16_ENCODE(BT_UUID_CTS_VAL)),
	BT_DATA_BYTES(BT_DATA_UUID128_ALL, BT_UUID_CUSTOM_SERVICE_VAL),
};

void mtu_updated(struct bt_conn *conn, uint16_t tx, uint16_t rx)
{
	printk("Updated MTU: TX: %d RX: %d bytes\n", tx, rx);
}

static struct bt_gatt_cb gatt_callbacks = {
	.att_mtu_updated = mtu_updated
};

static void connected(struct bt_conn *conn, uint8_t err)
{
	if (err) {
		printk("Connection failed (err 0x%02x)\n", err);
	} else {
		printk("Connected\n");
	}
}

static void disconnected(struct bt_conn *conn, uint8_t reason)
{
	printk("Disconnected (reason 0x%02x)\n", reason);
}

BT_CONN_CB_DEFINE(conn_callbacks) = {
	.connected = connected,
	.disconnected = disconnected,
};

static void bt_ready(void)
{
	int err;

	printk("Bluetooth initialized\n");

	cts_init();

	if (IS_ENABLED(CONFIG_SETTINGS)) {
		settings_load();
	}

	err = bt_le_adv_start(BT_LE_ADV_CONN_NAME, ad, ARRAY_SIZE(ad), NULL, 0);
	if (err) {
		printk("Advertising failed to start (err %d)\n", err);
		return;
	}

	printk("Advertising successfully started\n");
}

static void auth_passkey_display(struct bt_conn *conn, unsigned int passkey)
{
	char addr[BT_ADDR_LE_STR_LEN];

	bt_addr_le_to_str(bt_conn_get_dst(conn), addr, sizeof(addr));

	printk("Passkey for %s: %06u\n", addr, passkey);
}

static void auth_cancel(struct bt_conn *conn)
{
	char addr[BT_ADDR_LE_STR_LEN];

	bt_addr_le_to_str(bt_conn_get_dst(conn), addr, sizeof(addr));

	printk("Pairing cancelled: %s\n", addr);
}

static struct bt_conn_auth_cb auth_cb_display = {
	.passkey_display = auth_passkey_display,
	.passkey_entry = NULL,
	.cancel = auth_cancel,
};



void main(void)
{         
        len_of_value = 0;
        //TU si pouzivatel definuje funkcie a bajtove oznacenie, podla ktoreho zariadenie ma reagovat
        int (*measure_temerature)() = &get_temperature_value;
        int (*measure_humidity)() = &get_humidity_value;

        register_input(1, measure_temerature);
        register_input(2, measure_humidity);


        void (*led0_on)() = &turn_on_led0;
        void (*led1_on)() = &turn_on_led1;
        void (*led2_on)() = &turn_on_led2;

        void (*led0_off)() = &turn_off_led0;
        void (*led1_off)() = &turn_off_led1;
        void (*led2_off)() = &turn_off_led2;

        register_reaction(1, led0_on);
        register_reaction(2, led1_on);
        register_reaction(3, led2_on);

        register_reaction(4, led0_off);
        register_reaction(5, led1_off);
        register_reaction(6, led2_off);


        flash_dev = FLASH_AREA_DEVICE(STORAGE_NODE_LABEL);
	if (!device_is_ready(flash_dev)) {
		printk("Flash device %s is not ready\n", flash_dev->name);
		return;
	}
	fs.offset = FLASH_AREA_OFFSET(storage);
	rc = flash_get_page_info_by_offs(flash_dev, fs.offset, &info);
	if (rc) {
		printk("Unable to get page info\n");
		return;
	}
	fs.sector_size = info.size;
	fs.sector_count = 3U;

	rc = nvs_init(&fs, flash_dev->name);
	if (rc) {
		printk("Flash Init failed\n");
		return;
	} 

	/*BLE*/ 
	struct bt_gatt_attr *vnd_ind_attr;
	char str[BT_UUID_STR_LEN];
	int err;

	err = bt_enable(NULL);
	if (err) {
		printk("Bluetooth init failed (err %d)\n", err);
		return;
	}

	bt_ready();

	bt_gatt_cb_register(&gatt_callbacks);
	bt_conn_auth_cb_register(&auth_cb_display);

	vnd_ind_attr = bt_gatt_find_by_uuid(vnd_svc.attrs, vnd_svc.attr_count,
					    &vnd_enc_uuid.uuid);
	bt_uuid_to_str(&vnd_enc_uuid.uuid, str, sizeof(str));
	printk("Indicate VND attr %p (UUID %s)\n", vnd_ind_attr, str);


	/* Implement notification. At the moment there is no suitable way
	 * of starting delayed work so we do it here
	 */
        
      
        //scenar 1
        //int value_written_length_1 = 14;
        //unsigned char my_value_ok[] = {02,00,10,02,35, 00,01, 03, 00,10,02, 35, 00, 02};

        //scenar 2
        int value_written_length_1 = 28;
        unsigned char my_value_ok[] = {03,00,00,02,47,00,02,06,00,16,02,47,00,01,02,00,00,02,47,00,01,05,00,00,02,47,00,02};


	while (1) {
		k_sleep(K_SECONDS(2));

		
		if (simulate_vnd && vnd_ind_attr) {
			if (indicating) {
				continue;
			}

			ind_params.attr = vnd_ind_attr;
			ind_params.func = indicate_cb;
			ind_params.destroy = indicate_destroy;
			ind_params.data = &indicating;
			ind_params.len = sizeof(indicating);

			if (bt_gatt_indicate(NULL, &ind_params) == 0) {
				indicating = 1U;
			}
		}
                
                //printf("VALUE WRITTEN LENGTH: %d\n", value_written_length_1);
                //for(int i=0; i<value_written_length_1; i++){
                //  printf("MAIN: %d\n", my_value_ok[i]);
                //}
                //resolve(my_value_ok, value_written_length_1);


	}


}
```

## src/my_solution.c
```c
#include "my_solution.h"

#include <fs/nvs.h>
#include <stdio.h>

#include <devicetree.h>
#include <drivers/gpio.h>
#include <stdio.h>
#include <stdlib.h> //for using the function sleep
#include <time.h>

/*Temperature and Humidity*/
#include <drivers/sensor.h>
#include <stdio.h>
#include <sys/util.h>
#include <inttypes.h>
#include <logging/log.h>

LOG_MODULE_REGISTER(app, CONFIG_LOG_DEFAULT_LEVEL);

#define CONFIG_LENGTH 7

/*Flashing Preamle*/
#include <device.h>
#include <drivers/flash.h>
#include <fs/nvs.h>
#include <storage/flash_map.h>
#include <string.h>
#include <sys/reboot.h>
#include <zephyr.h>

static struct nvs_fs fs;

#define STORAGE_NODE_LABEL storage

#define LEN_ID 1
#define KEY_ID 3

int rc = 0;
uint8_t key[100];
struct flash_pages_info info;
const struct device *flash_dev;

// meno funkcie co sa nasledne vykona sa moze spracovavat v strukture aj ako void, aj ako char:
struct Logic_deciders {
  int logic_value;
  void *logic_name;
} first_byte[10];

struct Logic_deciderss {
  int logic_value;
  char *logic_name;
} fourth_byte[5];

static int fourth_counter = 0;
static int first_counter = 0;
static bool config_has_been_written = false;

static int measured_value;

// akcia a reakcia su jedna funkcia (navrh referencia)

// sem mi pride napriklad measure(temperature)
void register_input(uint8_t hexvalue, char *information) {
  fourth_byte[fourth_counter].logic_name = information;
  fourth_byte[fourth_counter].logic_value = hexvalue;
  fourth_counter += 1;
}

// sem pride napriklad turn on led0
void register_reaction(uint8_t hexvalue, void (*f)()) {
  first_byte[first_counter].logic_name = f;
  first_byte[first_counter].logic_value = hexvalue;
  first_counter += 1;
}
// execute function which came here
void execute_function_named(void (*f)(void)) {
  f();
}

// funkcia volana v maine
void resolve(char *value_incoming, int value_incoming_length) {


  //if (config_has_been_written == false) {
  //  printf("No config written yet!\n");
  //  return;
  //}

  printf("SOM V MOJOM RESOLVE\n");
  for (int i = 0; i < value_incoming_length; i++) {
    printf("..!!.. value_incoming[%d] = ", i);
    printf("%" PRIx32 "\n", value_incoming[i]);
    printf("or: %d\n", value_incoming[i]);
  }

  //spracovavame iba cele konfiguracie
  int number_of_configs = 0;
  if ((value_incoming_length) < CONFIG_LENGTH) {
    return;
  } else {
    number_of_configs = (value_incoming_length) / CONFIG_LENGTH;

    //if ((value_incoming_length-1) % CONFIG_LENGTH != 0) {

    //  // printf("number_of_configs % CONFIG_LENGTH = %d / %d = %d\n", value_incoming_length, CONFIG_LENGTH, number_of_configs);
    //  number_of_configs -= 1;
    //}
  }

  printf("Number of configs = %d / %d = %d\n", value_incoming_length, CONFIG_LENGTH, number_of_configs);

  // id of first bye
  int always_first_byte = 0;

  // action+reaction
  for (int iteration = 0; iteration < number_of_configs; iteration++) {
    
    void (*execute_action)();
    int (*execute_input)();

    for (int i = 0; i < first_counter; i++) {
      if (first_byte[i].logic_value == value_incoming[always_first_byte + 0]) {
        printf("ZHODA v 0tom: %d %d\n", value_incoming[always_first_byte + 0], first_byte[i].logic_value);
        execute_action = first_byte[i].logic_name;
     }
    }

    //input
    for (int i = 0; i < fourth_counter; i++) {
      if (always_first_byte + 3 > value_incoming_length) {
        continue;
      } else {
        if (fourth_byte[i].logic_value == value_incoming[always_first_byte + 3]) {
          printf("ZHODA v 3tom: %d %d\n", value_incoming[always_first_byte + 3], fourth_byte[i].logic_value);
          execute_input = fourth_byte[i].logic_name;        
        }
      }
    }

    int breaking_point = 0;

    if (always_first_byte + 4 > value_incoming_length) {
      continue;
    } else {
      breaking_point = value_incoming[always_first_byte + 4];
    }
    
     if (always_first_byte + 5 > value_incoming_length) {
      continue;
    } else {
      if(value_incoming[always_first_byte + 5] == 2){
        breaking_point *= (-1);
        printf("Breaking point is negated *(-1)\n");
      }
    }

    printf("BREAKING POINT: %d\n", breaking_point);

    // more/less/same
    if (always_first_byte + 6 > value_incoming_length) {
      continue;
    } else {
      //same
      if(value_incoming[always_first_byte + 6] == 0){
        if( execute_input() ==  breaking_point){
        execute_action();
        }      
      }

      //more
      if (value_incoming[always_first_byte + 6] == 1) {
        if (execute_input() > breaking_point) {
          execute_action();
        }
      }

      //less
      if(value_incoming[always_first_byte + 6] == 2){
        if( execute_input() <  breaking_point){
        execute_action();
        }
      }
    }

     // when we need time between executing configs,
    if (always_first_byte + 1 > value_incoming_length) {
      continue;
    } else {
      printf("value_incoming[%d]: sleep time: %d decisecond)\n", always_first_byte + 1, value_incoming[always_first_byte + 1] * 10000);
      k_msleep((value_incoming[always_first_byte + 1] * 10000));
    }
    if (always_first_byte + 2 > value_incoming_length) {
      continue;
    } else {
      printf("value_incoming[%d]: sleep time: %d miliseconds\n", always_first_byte + 2, value_incoming[always_first_byte + 2] * 100);
      k_msleep((value_incoming[always_first_byte + 2] * 100));
    }


    always_first_byte += CONFIG_LENGTH;

  //end of iteration
  }

}

static void process_sample(const struct device *dev) {
  static unsigned int obs;
  struct sensor_value temp, hum;
  if (sensor_sample_fetch(dev) < 0) {
    printf("Sensor sample update error\n");
    return;
  }

  if (sensor_channel_get(dev, SENSOR_CHAN_AMBIENT_TEMP, &temp) < 0) {
    printf("Cannot read HTS221 temperature channel\n");
    return;
  }

  if (sensor_channel_get(dev, SENSOR_CHAN_HUMIDITY, &hum) < 0) {
    printf("Cannot read HTS221 humidity channel\n");
    return;
  }
}

static void hts221_handler(const struct device *dev,
    const struct sensor_trigger *trig) {
  process_sample(dev);
}

int measure(char *get_value) {

  const struct device *dev_sensor = device_get_binding("HTS221");

  if (dev_sensor == NULL) {
    printf("Could not get HTS221 device\n");
    return;
  }

  if (IS_ENABLED(CONFIG_HTS221_TRIGGER)) {
    struct sensor_trigger trig = {
        .type = SENSOR_TRIG_DATA_READY,
        .chan = SENSOR_CHAN_ALL,
    };
    if (sensor_trigger_set(dev_sensor, &trig, hts221_handler) < 0) {
      printf("Cannot configure trigger\n");
      return;
    }
  }

  struct sensor_value temp, hum;

  if (sensor_sample_fetch(dev_sensor) < 0) {
    printf("Sensor sample update error\n");
    return;
  }

  if (sensor_channel_get(dev_sensor, SENSOR_CHAN_AMBIENT_TEMP, &temp) < 0) {
    printf("Cannot read HTS221 temperature channel\n");
    return;
  }

  if (sensor_channel_get(dev_sensor, SENSOR_CHAN_HUMIDITY, &hum) < 0) {
    printf("Cannot read HTS221 humidity channel\n");
    return;
  }

  int sensor_value;
  if (get_value == "temp") {
    /* display temperature */
    printf("\n 1. Temperature:%d C\n", temp.val1);
    sensor_value = temp.val1;
  }

  if (get_value == "hum") {
    /* display humidity */
    printf("\n 2. Humidity:%d %%\n", hum.val1);
    sensor_value = hum.val1;
  }

  return sensor_value;
}

int get_temperature_value() {
  return measure("temp");
}

int get_humidity_value() {
  return measure("hum");
}

void turn_on_led0() {
  const struct device *dev_t;
  bool led_is_on_t = true;
  int ret_t;

  dev_t = device_get_binding(DT_GPIO_LABEL(DT_ALIAS(led0), gpios));
  ret_t = gpio_pin_configure(dev_t, DT_GPIO_PIN(DT_ALIAS(led0), gpios), GPIO_OUTPUT_ACTIVE | DT_GPIO_FLAGS(DT_ALIAS(led0), gpios));
  gpio_pin_set(dev_t, DT_GPIO_PIN(DT_ALIAS(led0), gpios), (int)led_is_on_t);
}

void turn_on_led1() {
  const struct device *dev_t;
  bool led_is_on_t = true;
  int ret_t;

  dev_t = device_get_binding(DT_GPIO_LABEL(DT_ALIAS(led1), gpios));
  ret_t = gpio_pin_configure(dev_t, DT_GPIO_PIN(DT_ALIAS(led1), gpios), GPIO_OUTPUT_ACTIVE | DT_GPIO_FLAGS(DT_ALIAS(led1), gpios));
  gpio_pin_set(dev_t, DT_GPIO_PIN(DT_ALIAS(led1), gpios), (int)led_is_on_t);
}

void turn_on_led2() {
  const struct device *dev_t;
  bool led_is_on_t = true;
  int ret_t;

  dev_t = device_get_binding(DT_GPIO_LABEL(DT_ALIAS(led2), gpios));
  ret_t = gpio_pin_configure(dev_t, DT_GPIO_PIN(DT_ALIAS(led2), gpios), GPIO_OUTPUT_ACTIVE | DT_GPIO_FLAGS(DT_ALIAS(led2), gpios));
  gpio_pin_set(dev_t, DT_GPIO_PIN(DT_ALIAS(led2), gpios), (int)led_is_on_t);
}

void turn_off_led0() {
  const struct device *dev_t;
  bool led_is_on_t = false;
  int ret_t;

  dev_t = device_get_binding(DT_GPIO_LABEL(DT_ALIAS(led0), gpios));
  ret_t = gpio_pin_configure(dev_t, DT_GPIO_PIN(DT_ALIAS(led0), gpios), GPIO_OUTPUT_ACTIVE | DT_GPIO_FLAGS(DT_ALIAS(led0), gpios));
  gpio_pin_set(dev_t, DT_GPIO_PIN(DT_ALIAS(led0), gpios), (int)led_is_on_t);
}

void turn_off_led1() {
  const struct device *dev_t;
  bool led_is_on_t = false;
  int ret_t;

  dev_t = device_get_binding(DT_GPIO_LABEL(DT_ALIAS(led1), gpios));
  ret_t = gpio_pin_configure(dev_t, DT_GPIO_PIN(DT_ALIAS(led1), gpios), GPIO_OUTPUT_ACTIVE | DT_GPIO_FLAGS(DT_ALIAS(led1), gpios));
  gpio_pin_set(dev_t, DT_GPIO_PIN(DT_ALIAS(led1), gpios), (int)led_is_on_t);
}

void turn_off_led2() {
  const struct device *dev_t;
  bool led_is_on_t = false;
  int ret_t;

  dev_t = device_get_binding(DT_GPIO_LABEL(DT_ALIAS(led2), gpios));
  ret_t = gpio_pin_configure(dev_t, DT_GPIO_PIN(DT_ALIAS(led2), gpios), GPIO_OUTPUT_ACTIVE | DT_GPIO_FLAGS(DT_ALIAS(led2), gpios));
  gpio_pin_set(dev_t, DT_GPIO_PIN(DT_ALIAS(led2), gpios), (int)led_is_on_t);
}
```

## src/my_solution.h
```c
#ifndef FOO_DOT_H    /* This is an "include guard" */
#define FOO_DOT_H    /* prevents the file from being included twice. */
                     /* Including a header file twice causes all kinds */
                     /* of interesting problems.*/

/**
 * This is a function declaration.
 * It tells the compiler that the function exists somewhere.
 */
int foo();

#endif /* FOO_DOT_H */
```
